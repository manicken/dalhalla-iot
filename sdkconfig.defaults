## sdkconfig.defaults
```kconfig
CONFIG_ESP32_ENABLE_COREDUMP=y
CONFIG_ESP_COREDUMP_TO_FLASH=y
CONFIG_ESP_COREDUMP_LOG_LEVEL=1
CONFIG_ESP_COREDUMP_CHECKSUM_CRC32=y
CONFIG_ESP_COREDUMP_ENABLE_TO_FLASH=y
CONFIG_ESP_COREDUMP_DATA_FORMAT_ELF=y
```
